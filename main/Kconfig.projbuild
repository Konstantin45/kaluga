## main/Kconfig.projbuild
```kconfig
menu "Kaluga demo configuration"

config KALUGA_WIFI_CONNECT_ENABLED
    bool "Connect to a configured Wi-Fi network"
    default n
    help
        Enable station connection with credentials stored in sdkconfig.
        Network scanning is always available.

config KALUGA_WIFI_SSID
    string "Wi-Fi SSID"
    depends on KALUGA_WIFI_CONNECT_ENABLED
    default ""

config KALUGA_WIFI_PASSWORD
    string "Wi-Fi password"
    depends on KALUGA_WIFI_CONNECT_ENABLED
    default ""

endmenu
```

## sdkconfig.defaults
```kconfig
CONFIG_IDF_TARGET="esp32s2"
CONFIG_SPIRAM=y
CONFIG_SPIRAM_SPEED_80M=y
CONFIG_SPIRAM_TRY_ALLOCATE_WIFI_LWIP=y
CONFIG_SPIRAM_MALLOC_ALWAYSINTERNAL=4096
CONFIG_ESPTOOLPY_FLASHSIZE_4MB=y
CONFIG_PARTITION_TABLE_CUSTOM=y
CONFIG_PARTITION_TABLE_CUSTOM_FILENAME="partitions.csv"
CONFIG_FREERTOS_HZ=1000
CONFIG_TOUCH_SUPPRESS_DEPRECATE_WARN=y
CONFIG_LV_USE_CLIB_MALLOC=y
```
